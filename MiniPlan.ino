#include <Wire.h>
#include <Servo.h>
#include <ESP8266WiFi.h>
#include <ESP8266WebServer.h>
#include <Adafruit_PWMServoDriver.h>

// I2C Address 0x40
Adafruit_PWMServoDriver pwm = Adafruit_PWMServoDriver();

// Servos Matrix
const int ALLMATRIX = 19;          // 0 ~ 15 Servo + GPIO12 + GPIO14 + Run Time
const int ALLSERVOS = 18;        // 0 ~ 15 Servo + GPIO12 + GPIO14
const int PWMRES_Min = 1;        // PWM Resolution 1
const int PWMRES_Max = 120;   // PWM Resolution 120

// ES08MDII Pulse Traveling 1500us to 1900us , 120度
const int SERVOMIN = 1100;     // 1100
const int SERVOMAX = 2700;    // 2600

// Servo Delay Base Time
const int BASEDELAYTIME = 10;    // 10ms

// AP Password
const char WiFiAPPSK[] = "12345678";

int Servo_OE;
int Servo_PROGRAM;
int Servo_PROGRAM_Stack;
int GPIO_ID;
int GPIO12_PWM;
int GPIO14_PWM;

// Backup Servo Value
int Running_Servo_POS [ALLMATRIX];

ESP8266WebServer server(80);

Servo GPIO12SERVO;
Servo GPIO14SERVO;



/*============================================================================*/
// ES08MDII - Clear 誤差修正
///////////////////////////////////////////////////////    0    ,    1    ,    2    ,    3    ,    4    ,    5    ,    6    ,    7    ,    8    ,    9    ,    10   ,    11   ,    12   ,    13   ,    14   ,    15   ,   G12   ,  G14   ,  ms
//int Servo_Act_Fix [ ] PROGMEM = {   0,       -3,        2,       -1,       -2,        0,        0,        0,        0,        5,         3,         0,        -1,        -1,         0,        1,         3,         0,         0     };

// ES08MDII - Santa Claus 誤差修正
///////////////////////////////////////////////////////    0    ,    1    ,    2    ,    3    ,    4    ,    5    ,    6    ,    7    ,    8    ,    9    ,    10   ,    11   ,    12   ,    13   ,    14   ,    15   ,   G12   ,  G14   ,  ms
int Servo_Act_Fix [ ] PROGMEM = {  -7,       13,       9,        6,        7,       -2,       -3,       -6,       -8,       3,         0,        -1,         3,         7,         0,        -3,         -2,         0,         0     };


// ES08MDII - 無修正
///////////////////////////////////////////////////////    0    ,    1    ,    2    ,    3    ,    4    ,    5    ,    6    ,    7    ,    8    ,    9    ,    10   ,    11   ,    12   ,    13   ,    14   ,    15   ,   G12   ,  G14   ,  ms
//int Servo_Act_Fix [ ] PROGMEM = {   0,        0,        0,        0,        0,        0,         0,        0,        0,        0,         0,         0,         0,         0,         0,         0,         0,         0,         0     };

// ES08MDII - 達文西姿勢
/////////////////////////////////////////////////////    0    ,    1    ,    2    ,    3    ,    4    ,    5    ,    6    ,    7    ,    8    ,    9    ,    10   ,    11   ,    12   ,    13   ,    14   ,    15   ,   G12   ,  G14   ,  ms
int Servo_Act_0 [ ] PROGMEM = {   65,      35,      80,      60,      80,     100,     20,      80,      40,     100,      20,       30,       55,       35,       75,       50,        90,       90,        0     };

// ES08MDII - 立正
/////////////////////////////////////////////////////    0    ,    1    ,    2    ,    3    ,    4    ,    5    ,    6    ,    7    ,    8    ,    9    ,    10   ,    11   ,    12   ,    13   ,    14   ,    15   ,   G12   ,  G14   ,  ms
int Servo_Act_1 [ ] PROGMEM = {   65,      35,      80,      60,      80,     100,     95,      80,      40,      25,       20,       30,       55,       35,       75,       50,        90,       90,        0     };

/*============================================================================*/



// 待機姿勢
int Servo_Prg_0_Step = 1;
int Servo_Prg_0 [][ALLMATRIX] PROGMEM = {
  //    0    ,    1    ,    2    ,    3    ,    4    ,    5    ,    6    ,    7    ,    8    ,    9    ,    10   ,    11   ,    12   ,    13   ,    14   ,    15   ,   G12   ,  G14   ,  ms
  {    65,      35,      80,      60,      80,     100,     95,      80,      40,      25,       20,       30,       55,       35,       75,       50,        90,       90,      500   }     // 立正
};


// 鞠躬動作
int Servo_Prg_1_Step = 4;
int Servo_Prg_1 [][ALLMATRIX] PROGMEM = {
  //    0    ,    1    ,    2    ,    3    ,    4    ,    5    ,    6    ,    7    ,    8    ,    9    ,    10   ,    11   ,    12   ,    13   ,    14   ,    15   ,   G12   ,  G14   ,  ms
  {    65,      35,      80,      60,      80,     120,     80,      40,     110,     25,      100,      30,       55,       35,       75,       50,        90,       90,      500   },     // 立正 右手前平舉內彎 左手後擺
  {    65,      20,      80,      10,      80,     120,     80,      40,     110,     25,      100,      30,      102,      35,       90,       50,        90,       90,      500   },     // 立正 右手前平舉內彎 左手後擺 鞠躬
  {    65,      20,      80,      10,      80,     120,     80,      40,     110,     25,      100,      30,      102,      35,       90,       50,        90,       90,      1000 },     //  鞠躬動作 等待
  {    65,      35,      80,      60,      80,     100,     95,      80,      40,      25,       20,       30,       55,       35,       75,       50,        90,       90,      800   }      // 立正
};


// 揮手動作
int Servo_Prg_2_Step = 9;
int Servo_Prg_2 [][ALLMATRIX] PROGMEM = {
  //    0    ,    1    ,    2    ,    3    ,    4    ,    5    ,    6    ,    7    ,    8    ,    9    ,    10   ,    11   ,    12   ,    13   ,    14   ,    15   ,   G12   ,  G14   ,  ms
  {    65,      35,      80,      60,      80,     100,     95,      80,      20,      70,      120,      30,       55,       35,       75,       50,        50,       90,      500   },     // 立正 右手上抬向外 頭右轉
  {    65,      35,      80,      60,      80,     100,     95,      80,      40,      30,      120,      30,       55,       35,       75,       50,        50,       90,      300   },     // 立正 右手上抬向內 頭右轉
  {    65,      35,      80,      60,      80,     100,     95,      80,      20,      70,      120,      30,       55,       35,       75,       50,        50,       90,      300   },     // 立正 右手上抬向外 頭右轉
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  {    65,      35,      80,      60,      80,     100,     95,      80,      40,      25,       20,       30,       55,       35,       75,       50,        90,       90,      500   }      // 立正
};


// 鋼鐵人動作
int Servo_Prg_3_Step = 8;
int Servo_Prg_3 [][ALLMATRIX] PROGMEM = {
  //    0    ,    1    ,    2    ,    3    ,    4    ,    5    ,    6    ,    7    ,    8    ,    9    ,    10   ,    11   ,    12   ,    13   ,    14   ,    15   ,   G12   ,  G14   ,  ms
  {    75,      35,      80,      60,      90,     120,     70,     120,      0,      100,      20,       40,       55,       35,       75,       60,        50,       90,      300   },     // 身體左傾斜 右手上抬 掌向外 頭右轉
  {    75,      35,      80,      60,      90,     120,     70,     120,      0,      100,      20,       40,       55,       35,       75,       60,        50,       90,      800   },     // 身體左傾斜 右手上抬 掌向外 頭右轉
  {    55,      35,      80,      60,      70,     100,     20,     120,      0,       50,        0,        20,       55,       35,       75,       40,       130,      90,      300   },     // 身體右傾斜 左手上抬 掌向外 頭左轉
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  {    65,      35,      80,      60,      80,     100,     95,      80,      40,      25,       20,       30,       55,       35,       75,       50,        90,       90,      500   }      // 立正
};


// 阿帕契動作
int Servo_Prg_4_Step = 7;
int Servo_Prg_4 [][ALLMATRIX] PROGMEM = {
  //    0    ,    1    ,    2    ,    3    ,    4    ,    5    ,    6    ,    7    ,    8    ,    9    ,    10   ,    11   ,    12   ,    13   ,    14   ,    15   ,   G12   ,  G14   ,  ms
  {    55,      35,      80,      60,      70,     100,     70,      30,      40,      80,       20,       20,       55,       35,       75,       40,        90,       90,      500   },    // 身體右傾斜
  {    55,      35,      80,      60,      70,     100,     70,      30,      40,      80,       20,       20,       55,       35,       75,       35,       130,      90,      300   },    // 身體右傾斜 左腳預抬 頭左轉
  {    55,      35,      80,      60,      70,     100,     70,      30,     100,     10,      100,      40,       55,       35,       75,       30,       130,      90,      500   },    // 身體右傾斜 右手敬禮 左腳上抬 頭左轉
  {    55,      35,      80,      60,      70,     100,     70,      30,     100,     10,      100,      40,       55,       35,       75,       30,       130,      90,      800   },    // 身體右傾斜 右手敬禮 左腳上抬 頭左轉
  {    55,      35,      80,      60,      70,     100,     70,      30,      40,      80,       20,       20,       55,       35,       75,       35,       130,      90,      600   },    // 身體右傾斜 左腳預抬 頭左轉
  {    55,      35,      80,      60,      70,     100,     70,      30,      40,      80,       20,       20,       55,       35,       75,       40,        90,       90,      500   },    // 身體右傾斜
  {    65,      35,      80,      60,      80,     100,     95,      80,      40,      25,       20,       30,       55,       35,       75,       50,        90,       90,      500   }      // 立正
};


// 單腳平衡動作
int Servo_Prg_5_Step = 12;
int Servo_Prg_5 [][ALLMATRIX] PROGMEM = {
  //    0    ,    1    ,    2    ,    3    ,    4    ,    5    ,    6    ,    7    ,    8    ,    9    ,    10   ,    11   ,    12   ,    13   ,    14   ,    15   ,   G12   ,  G14   ,  ms
  {    75,      35,      80,      60,      90,     100,     20,      80,      40,     100,      20,       40,       55,       35,       75,       60,        90,       90,      500   },     // 身體左傾斜 雙手平舉上抬
  {    75,      35,      80,      60,      90,      50,      20,      80,      40,     100,      70,       40,       55,       35,       80,       60,        90,       90,      300   },     // 身體左傾斜 雙手平舉上抬旋轉 右腳預抬
  {    80,      35,      80,      60,      70,      50,      20,      80,      40,     100,      70,       40,       55,       35,       80,       60,        90,       90,      500   },     // 身體左傾斜 雙手平舉上抬旋轉 右腳上抬
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  {    65,      35,      80,      60,      80,     100,     95,      80,      40,      25,       20,       30,       55,       35,       75,       50,        90,       90,      500   }      // 立正
};


// 暖身動作
int Servo_Prg_6_Step = 16;
int Servo_Prg_6 [][ALLMATRIX] PROGMEM = {
  //    0    ,    1    ,    2    ,    3    ,    4    ,    5    ,    6    ,    7    ,    8    ,    9    ,    10   ,    11   ,    12   ,    13   ,    14   ,    15   ,   G12   ,  G14   ,  ms
  {    65,      35,      80,      60,      80,     100,     70,      20,     100,     50,       20,       30,       55,       35,       75,       50,        90,       90,      800   },     // 雙手插腰
  {    65,      35,      80,      60,      80,     100,     70,      20,     100,     50,       20,       30,       55,       35,       75,       50,        50,       90,      500   },     // 雙手插腰 頭右轉
  {    65,      35,      80,      60,      80,     100,     70,      20,     100,     50,       20,       30,       55,       35,       75,       50,        50,       90,      500   },     // 雙手插腰 頭右轉
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  {    65,      35,      80,      60,      80,     100,     95,      80,      40,      25,       20,       30,       55,       35,       75,       50,        90,       90,      800   }      // 立正
};


// 前進動作
int Servo_Prg_10_Step = 27;
int Servo_Prg_10 [][ALLMATRIX] PROGMEM = {
  //    0    ,    1    ,    2    ,    3    ,    4    ,    5    ,    6    ,    7    ,    8    ,    9    ,    10   ,    11   ,    12   ,    13   ,    14   ,    15   ,   G12   ,  G14   ,  ms
  {    65,      59,      36,      39,      80,     100,     95,      80,      40,      25,       20,       30,       75,       80,       50,       50,        90,       90,      500   },     // 淺蹲

  {    55,      59,      36,      39,      70,     100,     95,      80,      40,      25,       20,       20,       75,       80,       50,       40,        90,       90,      500   },     // 淺蹲 右傾斜
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  {    65,      35,      80,      60,      80,     100,     95,      80,      40,      25,       20,       30,       55,       35,       75,       50,        90,       90,      300   }      // 立正
};


// 後退動作
int Servo_Prg_11_Step = 19;
int Servo_Prg_11 [][ALLMATRIX] PROGMEM = {
  //    0    ,    1    ,    2    ,    3    ,    4    ,    5    ,    6    ,    7    ,    8    ,    9    ,    10   ,    11   ,    12   ,    13   ,    14   ,    15   ,   G12   ,  G14   ,  ms
  {    65,      59,      36,      39,      80,     100,     95,      80,      40,      25,       20,       30,       75,       80,       50,       50,        90,       90,      500   },     // 淺蹲

  {    55,      59,      36,      39,      70,     100,     95,      80,      40,      25,       20,       20,       75,       80,       50,       40,        90,       90,      500   },     // 淺蹲 右傾斜
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  {    65,      35,      80,      60,      80,     100,     95,      80,      40,      25,       20,       30,       55,       35,       75,       50,        90,       90,      300   }      // 立正
};


// 左轉動作
int Servo_Prg_12_Step = 27;
int Servo_Prg_12 [][ALLMATRIX] PROGMEM = {
  //    0    ,    1    ,    2    ,    3    ,    4    ,    5    ,    6    ,    7    ,    8    ,    9    ,    10   ,    11   ,    12   ,    13   ,    14   ,    15   ,   G12   ,  G14   ,  ms
  {    65,      59,      36,      39,      80,     100,     95,      80,      40,      25,       20,       30,       75,       80,       50,       50,        90,       90,      500   },     // 淺蹲

  {    75,      40,      45,      30,      90,     100,     95,      80,      40,      25,       20,       40,       75,       80,       50,       60,        90,       90,      500   },     // 淺蹲 左傾斜
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  {    65,      35,      80,      60,      80,     100,     95,      80,      40,      25,       20,       30,       55,       35,       75,       50,        90,       90,      300   }      // 立正
};


// 右轉動作
int Servo_Prg_13_Step = 27;
int Servo_Prg_13 [][ALLMATRIX] PROGMEM = {
  //    0    ,    1    ,    2    ,    3    ,    4    ,    5    ,    6    ,    7    ,    8    ,    9    ,    10   ,    11   ,    12   ,    13   ,    14   ,    15   ,   G12   ,  G14   ,  ms
  {    65,      59,      36,      39,      80,     100,     95,      80,      40,      25,       20,       30,       75,       80,       50,       50,        90,       90,      500   },     // 淺蹲

  {    55,      59,      36,      39,      70,     100,     95,      80,      40,      25,       20,       20,       75,       80,       50,       40,        90,       90,      500   },     // 淺蹲 右傾斜
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  {    65,      35,      80,      60,      80,     100,     95,      80,      40,      25,       20,       30,       55,       35,       75,       50,        90,       90,      300   }      // 立正
};



/*============================================================================*/
void setup(void) {

  // PCA9685 OE PIN
  //Serial.begin(9600);
  //Serial.println("miniPlen start");
  pinMode(13, OUTPUT);
  digitalWrite(13, LOW);


  // Software PWM PIN
  GPIO12SERVO.attach(12);
  GPIO14SERVO.attach(14);


  // Initialize I2C
  Wire.begin(4, 5);


  // PWMServoDriver
  pwm.begin();
  pwm.setPWMFreq(320);   // servos run at 300Hz updates


  // 清除備份目前馬達數值
  for ( int Index = 0; Index < ALLMATRIX; Index++)
  {
    Running_Servo_POS[Index] = Servo_Act_1[Index] + Servo_Act_Fix[Index];
  }


  // AP SSID Name
  uint8_t mac[WL_MAC_ADDR_LENGTH];
  WiFi.softAPmacAddress(mac);
  String macID = String(mac[WL_MAC_ADDR_LENGTH - 2], HEX) +
                 String(mac[WL_MAC_ADDR_LENGTH - 1], HEX);
  macID.toUpperCase();
  String AP_NameString = "ROB" + macID;

  char AP_NameChar[AP_NameString.length() + 1];
  memset(AP_NameChar, AP_NameString.length() + 1, 0);

  for (int i = 0; i < AP_NameString.length(); i++)
    AP_NameChar[i] = AP_NameString.charAt(i);

  WiFi.softAP(AP_NameChar, WiFiAPPSK);
  IPAddress myIP = WiFi.softAPIP();


  // 網頁形成
  //  server.on("/", []() {
  //    server.send(20, "text/plain", "Open /servo?id=0&pwm=90&oe=1 to control servo");
  //  });
   enableWebServer();
   //Serial.println("service start");

  // 讀取網頁回傳
  /*
  server.on("/servo", []() {
    String ival;

    // OE , LOW = On , High = Off
    ival = server.arg("oe");
    Servo_OE = ival.toInt();

    ival = server.arg("pm");
    Servo_PROGRAM = ival.toInt();

    ival = server.arg("pms");
    Servo_PROGRAM_Stack = ival.toInt();

    ival = server.arg("gpid");
    GPIO_ID = ival.toInt();

    if (GPIO_ID == 12) {
      ival = server.arg("pwm");
      GPIO12_PWM = ival.toInt() + Servo_Act_Fix[16];
      GPIO12SERVO.write(GPIO12_PWM);
    }

    if (GPIO_ID == 14) {
      ival = server.arg("pwm");
      GPIO14_PWM = ival.toInt() + Servo_Act_Fix[17];
      GPIO14SERVO.write(GPIO14_PWM);
    }

    if (Servo_PROGRAM == 0 && Servo_PROGRAM_Stack == 0 && GPIO_ID == 0) {
      ival = server.arg("id");
      int Servo_ID = ival.toInt();
      ival = server.arg("pwm");
      int Servo_PWM = ival.toInt() + Servo_Act_Fix[Servo_ID];
      int pulselength = map(Servo_PWM, PWMRES_Min, PWMRES_Max, SERVOMIN, SERVOMAX);
      pwm.setPWM(Servo_ID, 0, pulselength);
    }

    server.send(10, "text/plain");
  });

  server.begin();
  */

}



/*============================================================================*/
void Servo_PROGRAM_Zero()
{
  // 清除備份目前馬達數值
  for ( int Index = 0; Index < ALLMATRIX; Index++)
  {
    Running_Servo_POS[Index] = Servo_Act_0[Index] + Servo_Act_Fix[Index];
  }

  // 重新載入馬達預設數值
  for (int iServo = 0; iServo < ALLSERVOS; iServo++)
  {
    Set_PWM_to_Servo(iServo, Running_Servo_POS[iServo]);
    delay(10);
  }
}



/*============================================================================*/
void Servo_PROGRAM_Center()
{
  // 清除備份目前馬達數值
  for ( int Index = 0; Index < ALLMATRIX; Index++)
  {
    Running_Servo_POS[Index] = Servo_Act_1[Index] + Servo_Act_Fix[Index];
  }

  // 重新載入馬達預設數值
  for (int iServo = 0; iServo < ALLSERVOS; iServo++)
  {
    Set_PWM_to_Servo(iServo, Running_Servo_POS[iServo]);
    delay(10);
  }
}



/*============================================================================*/
void Set_PWM_to_Servo(int iServo, int iValue)
{
  int NewPWM = map(iValue, PWMRES_Min, PWMRES_Max, SERVOMIN, SERVOMAX);

  if (iServo >= 17)
  {
    GPIO14SERVO.write(iValue);
  }
  else if (iServo >= 16)
  {
    GPIO12SERVO.write(iValue);
  }
  else
  {
    pwm.setPWM(iServo, 0, NewPWM);
  }
}



/*============================================================================*/
void Servo_PROGRAM_Run(int iMatrix[][19],  int iSteps)
{
  int INT_TEMP_A, INT_TEMP_B, INT_TEMP_C;

  for ( int MainLoopIndex = 0; MainLoopIndex < iSteps; MainLoopIndex++)  // iSteps 步驟主迴圈
  {
    // InterTotalTime 此步驟總時間
    int InterTotalTime = iMatrix [ MainLoopIndex ] [ ALLMATRIX - 1 ] + Servo_Act_Fix[ALLMATRIX - 1];

    // InterDelayCounter 此步驟基本延遲次數
    int InterDelayCounter = InterTotalTime / BASEDELAYTIME;

    // 內差次數迴圈
    for ( int InterStepLoop = 0; InterStepLoop < InterDelayCounter; InterStepLoop++)
    {

      for (int ServoIndex = 0; ServoIndex < ALLSERVOS; ServoIndex++)  // 馬達主迴圈
      {

        INT_TEMP_A = Running_Servo_POS[ServoIndex];                                                    // 馬達現在位置
        INT_TEMP_B = iMatrix[MainLoopIndex][ServoIndex] + Servo_Act_Fix[ServoIndex];    // 馬達目標位置

        if (INT_TEMP_A == INT_TEMP_B)         // 馬達數值不變
        {
          INT_TEMP_C = INT_TEMP_B;
        }

        else if (INT_TEMP_A > INT_TEMP_B)   // 馬達數值減少
        {
          // PWM內差值 = map( 執行次數時間累加, 開始時間, 結束時間, 內差起始值, 內差最大值 )
          INT_TEMP_C =  map(BASEDELAYTIME * InterStepLoop, 0, InterTotalTime, 0, INT_TEMP_A - INT_TEMP_B);

          if (INT_TEMP_A - INT_TEMP_C >= INT_TEMP_B)
          {
            Set_PWM_to_Servo(ServoIndex, INT_TEMP_A - INT_TEMP_C);
          }
        }

        else if (INT_TEMP_A < INT_TEMP_B)   // 馬達數值增加
        {
          // PWM內差值 = map( 執行次數時間累加, 開始時間, 結束時間, 內差起始值, 內差最大值 )
          INT_TEMP_C =  map(BASEDELAYTIME * InterStepLoop, 0, InterTotalTime, 0, INT_TEMP_B - INT_TEMP_A);

          if (INT_TEMP_A + INT_TEMP_C <= INT_TEMP_B)
          {
            Set_PWM_to_Servo(ServoIndex, INT_TEMP_A + INT_TEMP_C);
          }
        }

      }

      delay(BASEDELAYTIME);
    }

    // 備份目前馬達數值
    for ( int Index = 0; Index < ALLMATRIX; Index++)
    {
      Running_Servo_POS[Index] = iMatrix[MainLoopIndex][Index] + Servo_Act_Fix[Index];
    }

  }

}



/*============================================================================*/
void loop(void) {

  server.handleClient();

  if (Servo_PROGRAM >= 1 )
  {
    switch (Servo_PROGRAM)
    {
      case 1:  // 前進
        Servo_PROGRAM_Run(Servo_Prg_10, Servo_Prg_10_Step);
        Servo_PROGRAM_Center();
        break;
      case 2:  // 後退
        Servo_PROGRAM_Run(Servo_Prg_11, Servo_Prg_11_Step);
        Servo_PROGRAM_Center();
        break;
      case 3:  // 左轉
        Servo_PROGRAM_Run(Servo_Prg_12, Servo_Prg_12_Step);
        Servo_PROGRAM_Center();
        break;
      case 4:  // 右轉
        Servo_PROGRAM_Run(Servo_Prg_13, Servo_Prg_13_Step);
        Servo_PROGRAM_Center();
        break;
      case 99:  // 待機
        Servo_PROGRAM_Center();
        delay(300);
        break;
      case 100:  // 待機
        Servo_PROGRAM_Zero();
        delay(300);
        break;
    }
    Servo_PROGRAM = 0;
  }

  if (Servo_PROGRAM_Stack >= 1)
  {
    switch (Servo_PROGRAM_Stack)
    {
      case 1:  // 動作 1
        Servo_PROGRAM_Run(Servo_Prg_1, Servo_Prg_1_Step);
        Servo_PROGRAM_Center();
        break;
      case 2:  // 動作 2
        Servo_PROGRAM_Run(Servo_Prg_2, Servo_Prg_2_Step);
        Servo_PROGRAM_Center();
        break;
      case 3:  // 動作 3
        Servo_PROGRAM_Run(Servo_Prg_3, Servo_Prg_3_Step);
        Servo_PROGRAM_Center();
        break;
      case 4:  // 動作 4
        Servo_PROGRAM_Run(Servo_Prg_4, Servo_Prg_4_Step);
        Servo_PROGRAM_Center();
        break;
      case 5:  // 動作 5
        Servo_PROGRAM_Run(Servo_Prg_5, Servo_Prg_5_Step);
        Servo_PROGRAM_Center();
        break;
      case 6:  // 動作 6
        Servo_PROGRAM_Run(Servo_Prg_6, Servo_Prg_6_Step);
        Servo_PROGRAM_Center();
        break;
      case 99:  // 動作 AUTO DEMO
        Servo_PROGRAM_Run(Servo_Prg_1, Servo_Prg_1_Step);
        Servo_PROGRAM_Center();
        delay(1000);
        Servo_PROGRAM_Run(Servo_Prg_2, Servo_Prg_2_Step);
        Servo_PROGRAM_Center();
        delay(1000);
        Servo_PROGRAM_Run(Servo_Prg_6, Servo_Prg_6_Step);
        Servo_PROGRAM_Center();
        delay(1000);
        Servo_PROGRAM_Run(Servo_Prg_3, Servo_Prg_3_Step);
        Servo_PROGRAM_Center();
        delay(1000);
        Servo_PROGRAM_Run(Servo_Prg_4, Servo_Prg_4_Step);
        Servo_PROGRAM_Center();
        delay(1000);
        Servo_PROGRAM_Run(Servo_Prg_5, Servo_Prg_5_Step);
        Servo_PROGRAM_Center();
        delay(1000);
        Servo_PROGRAM_Run(Servo_Prg_1, Servo_Prg_1_Step);
        Servo_PROGRAM_Center();
        break;
    }
    Servo_PROGRAM_Stack = 0;
  }

}
void handleAction(WiFiClient client, String req, HTTPMethod method) {
  
  server.send(200, "text/plain", "hello from esp8266!");
  
}

void handleController() {
  String pm = server.arg("pm");
  String pms = server.arg("pms");
  String servo = server.arg("servo");
  String gpid = server.arg("gpid");

  //ival = server.arg("pm");
  if(pm!=""){
    Servo_PROGRAM = pm.toInt();
  }
  //ival = server.arg("pms");
  if(pms!=""){
    Servo_PROGRAM_Stack = pms.toInt();
  }
  if(servo!=""){
    //ival = server.arg("id");
      int Servo_ID = servo.toInt();
      String ival = server.arg("value");
      int Servo_PWM = ival.toInt();
      int pulselength = map(Servo_PWM, 0, 180, SERVOMIN, SERVOMAX);
      pwm.setPWM(Servo_ID, 0, pulselength);
  }
  if(gpid!=""){
    GPIO_ID = gpid.toInt();
    if (GPIO_ID == 12) {
      String ival = server.arg("value");
      GPIO12_PWM = ival.toInt();
      GPIO12SERVO.write(GPIO12_PWM);
    }
    if (GPIO_ID == 14) {
      String ival = server.arg("value");
      GPIO14_PWM = ival.toInt();
      GPIO14SERVO.write(GPIO14_PWM);
    }
  }

  
  server.send(200, "text/html", "(pm, pms)=("+pm+","+pms+")");
  
  
 
  
  //digitalWrite(led, 0);
}
void handlerEditor(){

  String content = "";
content += "<html>";
content += "<head>";
content += "  <title>MiniPlen Controller</title>";
content += "  <style type=\"text/css\">";
content += "  body {";
content += "    color: white;";
content += "    background-color: #000000 }";

content += "  .pm_btn {";
content += "  -webkit-border-radius: 5;";
content += "  -moz-border-radius: 5;";
content += "  border-radius: 5px;";
content += "  font-family: Arial;";
content += "  color: #ffffff;";
content += "  font-size: 24px;";
content += "  background: #3498db;";
content += "  padding: 10px 20px 10px 20px;";
content += "  text-decoration: none;";
content += "}";

content += ".pm_text {";
content += "width: 50%;";
content += "-webkit-border-radius: 5;";
content += "-moz-border-radius: 5;";
content += "border-radius: 5px;";
content += "font-family: Arial;";
content += "font-size: 24px;";
content += "padding: 10px 20px 10px 20px;";
content += "text-decoration: none;";
content += "}";

content += ".pm_btn:hover {";
content += "  background: #3cb0fd;";
content += "  background-image: -webkit-linear-gradient(top, #3cb0fd, #3498db);";
content += "  background-image: -moz-linear-gradient(top, #3cb0fd, #3498db);";
content += "  background-image: -ms-linear-gradient(top, #3cb0fd, #3498db);";
content += "  background-image: -o-linear-gradient(top, #3cb0fd, #3498db);";
content += "  background-image: linear-gradient(to bottom, #3cb0fd, #3498db);";
content += "  text-decoration: none;";
content += "}";

content += ".pms_btn {";
content += "-webkit-border-radius: 5;";
content += "-moz-border-radius: 5;";
content += "border-radius: 5px;";
content += "font-family: Arial;";
content += "color: #ffffff;";
content += "font-size: 24px;";
content += "background: #3498db;";
content += "padding: 10px 20px 10px 20px;";
content += "text-decoration: none;";
content += "}";

content += ".pms_btn:hover {";
content += "background: #3cb0fd;";
content += "background-image: -webkit-linear-gradient(top, #3cb0fd, #3498db);";
content += "background-image: -moz-linear-gradient(top, #3cb0fd, #3498db);";
content += "background-image: -ms-linear-gradient(top, #3cb0fd, #3498db);";
content += "background-image: -o-linear-gradient(top, #3cb0fd, #3498db);";
content += "background-image: linear-gradient(to bottom, #3cb0fd, #3498db);";
content += "text-decoration: none;";
content += "}";
content += "  </style>";
content += "</head>";
content += "<body>";
content += "<table width=\"100%\">";
content += "<tr>";

content += "<td width=\"50%\">GPID14<br/><input class=\"pm_text\" type=\"text\" id=\"gpid_14\" value=\"90\"><button class=\"pm_btn\" type=\"button\" onclick=\"controlGpid(14, 'gpid_14')\">SEND</button></td>";
content += "<td width=\"50%\">GPID12<br/><input class=\"pm_text\" type=\"text\" id=\"gpid_12\"  value=\"90\"><button class=\"pm_btn\" type=\"button\" onclick=\"controlGpid(12, 'gpid_12')\">SEND</button></td>";
content += "</tr>";

content += "<tr>";
content += "<td>Servo8<br/><input class=\"pm_text\" type=\"text\" id=\"servo_8\" value=\"40\"><button class=\"pm_btn\" type=\"button\" onclick=\"controlServo(8,'servo_8')\">SEND</button></td>";
content += "<td>Servo7<br/><input class=\"pm_text\" type=\"text\" id=\"servo_7\" value=\"80\"><button class=\"pm_btn\" type=\"button\" onclick=\"controlServo(7, 'servo_7')\">SEND</button></td>";
content += "</tr>";

content += "<tr>";
content += "<td>Servo9<br/><input class=\"pm_text\" type=\"text\" id=\"servo_9\" value=\"100\"><button class=\"pm_btn\" type=\"button\" onclick=\"controlServo(9,'servo_9')\">SEND</button></td>";
content += "<td>Servo6<br/><input class=\"pm_text\" type=\"text\" id=\"servo_6\" value=\"20\"><button class=\"pm_btn\" type=\"button\" onclick=\"controlServo(6,'servo_6')\">SEND</button></td>";
content += "</tr>";

content += "<tr>";
content += "<td>Servo10<br/><input class=\"pm_text\" type=\"text\" id=\"servo_10\" value=\"20\"><button class=\"pm_btn\" type=\"button\" onclick=\"controlServo(10,'servo_10')\">SEND</button></td>";
content += "<td>Servo5<br/><input class=\"pm_text\" type=\"text\" id=\"servo_5\" value=\"10\"><button class=\"pm_btn\" type=\"button\" onclick=\"controlServo(5,'servo_5')\">SEND</button></td>";
content += "</tr>";

content += "<tr>";
content += "<td>Servo11<br/><input class=\"pm_text\" type=\"text\" id=\"servo_11\"><button class=\"pm_btn\" type=\"button\" onclick=\"controlServo(11,'servo_11')\">SEND</button></td>";
content += "<td>Servo4<br/><input class=\"pm_text\" type=\"text\" id=\"servo_4\"><button class=\"pm_btn\" type=\"button\" onclick=\"controlServo(4,'servo_4')\">SEND</button></td>";
content += "</tr>";


content += "<tr>";
content += "<td>Servo12<br/><input class=\"pm_text\" type=\"text\" id=\"servo_12\"><button class=\"pm_btn\" type=\"button\" onclick=\"controlServo(12,'servo_12')\">SEND</button></td>";
content += "<td>Servo3<br/><input class=\"pm_text\" type=\"text\" id=\"servo_3\"><button class=\"pm_btn\" type=\"button\" onclick=\"controlServo(3,'servo_3')\">SEND</button></td>";
content += "</tr>";


content += "<tr>";
content += "<td>Servo13<br/><input class=\"pm_text\" type=\"text\" id=\"servo_13\"><button class=\"pm_btn\" type=\"button\" onclick=\"controlServo(13,'servo_13')\">SEND</button></td>";
content += "<td>Servo2<br/><input class=\"pm_text\" type=\"text\" id=\"servo_2\"><button class=\"pm_btn\" type=\"button\" onclick=\"controlServo(2,'servo_2')\">SEND</button></td>";
content += "</tr>";


content += "<tr>";
content += "<td>Servo14<br/><input class=\"pm_text\" type=\"text\"  id=\"servo_14\"><button class=\"pm_btn\" type=\"button\" onclick=\"controlServo(14,'servo_14')\">SEND</button></td>";
content += "<td>Servo1<br/><input class=\"pm_text\" type=\"text\" id=\"servo_1\"><button class=\"pm_btn\" type=\"button\" onclick=\"controlServo(1,'servo_1')\">SEND</button></td>";
content += "</tr>";

content += "<tr>";
content += "<td>Servo15<br/><input class=\"pm_text\" type=\"text\"  id=\"servo_15\"><button class=\"pm_btn\" type=\"button\" onclick=\"controlServo(15,'servo_15')\">SEND</button></td>";
content += "<td>Servo0<br/><input class=\"pm_text\" type=\"text\" id=\"servo_0\"><button class=\"pm_btn\" type=\"button\" onclick=\"controlServo(0,'servo_0')\">SEND</button></td>";
content += "</tr>";


content += "</table>";
content += "<br>";


content += "</body>";
content += "<script>";

content += "function controlServo(id, textId) {";
content += "  var xhttp = new XMLHttpRequest();";
content += "  var value = document.getElementById(textId).value;";
content += "  xhttp.onreadystatechange = function() {";
content += "    if (xhttp.readyState == 4 && xhttp.status == 200) {";
content += "     document.getElementById(\"demo\").innerHTML = xhttp.responseText;";
content += "    }";
content += "  };";
content += "  xhttp.open(\"GET\",\"controller?servo=\"+id+\"&value=\"+value, true);";
content += "  xhttp.send();";
content += "}";
content += "function controlGpid(id, textId) {";
content += "  var xhttp = new XMLHttpRequest();";
content += "  var value = document.getElementById(textId).value;";
content += "  xhttp.onreadystatechange = function() {";
content += "    if (xhttp.readyState == 4 && xhttp.status == 200) {";
content += "     document.getElementById(\"demo\").innerHTML = xhttp.responseText;";
content += "    }";
content += "  };";
content += "  xhttp.open(\"GET\", \"controller?gpid=\"+id+\"&value=\"+value, true);";
content += "  xhttp.send();";
content += "}";

content += "function controlPm(value) {";
content += "  var xhttp = new XMLHttpRequest();";
content += "  xhttp.onreadystatechange = function() {";
content += "    if (xhttp.readyState == 4 && xhttp.status == 200) {";
content += "     document.getElementById(\"demo\").innerHTML = xhttp.responseText;";
content += "    }";
content += "  };";
content += "  xhttp.open(\"GET\", \"controller?pm=\"+value, true);";
content += "  xhttp.send();";
content += "}";



content += "</script>";
content += "</html>";
server.send(200, "text/html", content);
  
}

void handleZero(){

  String content = "";
content += "<html>";
content += "<head>";
content += "<title>MiniPlen Controller</title>";
content += " <style type=\"text/css\">";
content += "  body {";
content += "    color: white;";
content += "    background-color: #000000 }";

content += "  .pm_btn {";
//content += "  width: 160px;";
content += "  -webkit-border-radius: 5;";
content += "  -moz-border-radius: 5;";
content += "  border-radius: 5px;";
content += "  font-family: Arial;";
content += "  color: #ffffff;";
content += "  font-size: 24px;";
content += "  background: #3498db;";
content += "  padding: 10px 20px 10px 20px;";
content += "  text-decoration: none;";
content += "}";
content += ".pm_text {";
//content += "width: 160px;";
content += "-webkit-border-radius: 5;";
content += "-moz-border-radius: 5;";
content += "border-radius: 5px;";
content += "font-family: Arial;";
content += "font-size: 24px;";

content += "padding: 10px 20px 10px 20px;";
content += "text-decoration: none;";
content += "}";

content += ".pm_btn:hover {";
content += "  background: #3cb0fd;";
content += "  background-image: -webkit-linear-gradient(top, #3cb0fd, #3498db);";
content += "  background-image: -moz-linear-gradient(top, #3cb0fd, #3498db);";
content += "  background-image: -ms-linear-gradient(top, #3cb0fd, #3498db);";
content += "  background-image: -o-linear-gradient(top, #3cb0fd, #3498db);";
content += "  background-image: linear-gradient(to bottom, #3cb0fd, #3498db);";
content += "  text-decoration: none;";
content += "}";

content += ".pms_btn {";
//content += "width: 240px;";
content += "-webkit-border-radius: 5;";
content += "-moz-border-radius: 5;";
content += "border-radius: 5px;";
content += "font-family: Arial;";
content += "color: #ffffff;";
content += "font-size: 24px;";
content += "background: #3498db;";
content += "padding: 10px 20px 10px 20px;";
content += "text-decoration: none;";
content += "}";

content += ".pms_btn:hover {";
content += "background: #3cb0fd;";
content += "background-image: -webkit-linear-gradient(top, #3cb0fd, #3498db);";
content += "background-image: -moz-linear-gradient(top, #3cb0fd, #3498db);";
content += "background-image: -ms-linear-gradient(top, #3cb0fd, #3498db);";
content += "background-image: -o-linear-gradient(top, #3cb0fd, #3498db);";
content += "background-image: linear-gradient(to bottom, #3cb0fd, #3498db);";
content += "text-decoration: none;";
content += "}";
content += "  </style>";
content += "</head>";
content += "<body>";


content += "<table width=\"100%\">";
content += "<tr>";

content += "<td width=\"50%\"><button class=\"pm_btn\" type=\"button\" onclick=\"controlGpid(14, 90)\">GPIO14</button></td>";
content += "<td width=\"50%\"><button class=\"pm_btn\" type=\"button\" onclick=\"controlGpid(12, 90)\">GPIO12</button></td>";
content += "</tr>";

content += "<tr>";
content += "<td><button class=\"pm_btn\" type=\"button\" onclick=\"controlServo(8,90)\">Servo 10</button></td>";
content += "<td><button class=\"pm_btn\" type=\"button\" onclick=\"controlServo(7, 60)\">Servo 5</button></td>";
content += "</tr>";

content += "<tr>";
content += "<td><button class=\"pm_btn\" type=\"button\" onclick=\"controlServo(9,90)\">Servo 9</button></td>";
content += "<td><button class=\"pm_btn\" type=\"button\" onclick=\"controlServo(6,'servo_6')\">Servo 6</button></td>";
content += "</tr>";

content += "<tr>";
content += "<td><button class=\"pm_btn\" type=\"button\" onclick=\"controlServo(8,90)\">Servo 8</button></td>";
content += "<td><button class=\"pm_btn\" type=\"button\" onclick=\"controlServo(7,90)\">Servo 7</button></td>";
content += "</tr>";

content += "<tr>";
content += "<td><button class=\"pm_btn\" type=\"button\" onclick=\"controlServo(11,90)\">Servo 11</button></td>";
content += "<td><button class=\"pm_btn\" type=\"button\" onclick=\"controlServo(4,90)\">Servo 4</button></td>";
content += "</tr>";


content += "<tr>";
content += "<td><button class=\"pm_btn\" type=\"button\" onclick=\"controlServo(12,90)\">Servo 12</button></td>";
content += "<td><button class=\"pm_btn\" type=\"button\" onclick=\"controlServo(3,90)\">Servo 3</button></td>";
content += "</tr>";


content += "<tr>";
content += "<td><button class=\"pm_btn\" type=\"button\" onclick=\"controlServo(13,90)\">Servo 13</button></td>";
content += "<td><button class=\"pm_btn\" type=\"button\" onclick=\"controlServo(2,90)\">Servo 2</button></td>";
content += "</tr>";


content += "<tr>";
content += "<td><button class=\"pm_btn\" type=\"button\" onclick=\"controlServo(14,90)\">Servo 14</button></td>";
content += "<td><button class=\"pm_btn\" type=\"button\" onclick=\"controlServo(1,90)\">Servo 1</button></td>";
content += "</tr>";

content += "<tr>";
content += "<td><button class=\"pm_btn\" type=\"button\" onclick=\"controlServo(15,90)\">Servo 15</button></td>";
content += "<td><button class=\"pm_btn\" type=\"button\" onclick=\"controlServo(0,90)\">Servo 0</button></td>";
content += "</tr>";

content += "<tr>";
content += "<td colspan=\"2\"><button class=\"pm_btn\" type=\"button\" onclick=\"controlPm(100)\">ALL</button></td>";
content += "</tr>";


content += "</table>";
content += "<br>";


content += "</body>";
content += "<script>";
content += "function controlServo(id, value) {";
content += "  var xhttp = new XMLHttpRequest();";

content += "  xhttp.onreadystatechange = function() {";
content += "    if (xhttp.readyState == 4 && xhttp.status == 200) {";
content += "     document.getElementById(\"demo\").innerHTML = xhttp.responseText;";
content += "    }";
content += "  };";
content += "  xhttp.open(\"GET\", \"controller?servo=\"+id+\"&value=\"+value, true);";
content += "  xhttp.send();";
content += "}";
content += "function controlGpid(id, value) {";
content += "  var xhttp = new XMLHttpRequest();";

content += "  xhttp.onreadystatechange = function() {";
content += "    if (xhttp.readyState == 4 && xhttp.status == 200) {";
content += "     document.getElementById(\"demo\").innerHTML = xhttp.responseText;";
content += "    }";
content += "  };";
content += "  xhttp.open(\"GET\", \"controller?gpid=\"+id+\"&value=\"+value, true);";
content += "  xhttp.send();";
content += "}";

content += "function controlPm(value) {";
content += "  var xhttp = new XMLHttpRequest();";
content += "  xhttp.onreadystatechange = function() {";
content += "    if (xhttp.readyState == 4 && xhttp.status == 200) {";
content += "     document.getElementById(\"demo\").innerHTML = xhttp.responseText;";
content += "    }";
content += "  };";
content += "  xhttp.open(\"GET\", \"controller?pm=\"+value, true);";
content += "  xhttp.send();";
content += "}";

content += "</script>";
content += "</html>";

server.send(200, "text/html", content);
  
}

void handleIndex() {

  String content = "";
  content +="<html>";

  content +="<head>";
  content +="  <title>MiniPlen Controller</title>";
  content +="  <style type=\"text/css\">";
  content +="  body {";
  content +="    color: purple;";
  content +="    background-color: #000000 }";

  content +="  .pm_btn {";
  content +="  width: 160px;";
  content +="  -webkit-border-radius: 5;";
  content +="  -moz-border-radius: 5;";
  content +="  border-radius: 5px;";
  content +="  font-family: Arial;";
  content +="  color: #ffffff;";
   content +=" font-size: 24px;";
  content +="background: #3498db;";
  content +="  padding: 10px 20px 10px 20px;";
  content +="  text-decoration: none;";
  content +="}";

  content +=".pm_btn:hover {";
  content +="  background: #3cb0fd;";
  content +="  background-image: -webkit-linear-gradient(top, #3cb0fd, #3498db);";
  content +="  background-image: -moz-linear-gradient(top, #3cb0fd, #3498db);";
  content +="  background-image: -ms-linear-gradient(top, #3cb0fd, #3498db);";
  content +="  background-image: -o-linear-gradient(top, #3cb0fd, #3498db);";
  content +="  background-image: linear-gradient(to bottom, #3cb0fd, #3498db);";
  content +="  text-decoration: none;";
  content +="}";

  content +=".pms_btn {";
  content +="width: 240px;";
  content +="-webkit-border-radius: 5;";
  content +="-moz-border-radius: 5;";
  content +="border-radius: 5px;";
  content +="font-family: Arial;";
  content +="color: #ffffff;";
  content +="font-size: 24px;";
  content +="background: #3498db;";
  content +="padding: 10px 20px 10px 20px;";
  content +="text-decoration: none;";
  content +="}";

  content +=".pms_btn:hover {";
  content +="background: #3cb0fd;";
  content +="background-image: -webkit-linear-gradient(top, #3cb0fd, #3498db);";
  content +="background-image: -moz-linear-gradient(top, #3cb0fd, #3498db);";
  content +="background-image: -ms-linear-gradient(top, #3cb0fd, #3498db);";
  content +="background-image: -o-linear-gradient(top, #3cb0fd, #3498db);";
  content +="background-image: linear-gradient(to bottom, #3cb0fd, #3498db);";
  content +="text-decoration: none;";
  content +="}";
   content +=" </style>";
  content +="</head>";


  
  content +="<body>";
  content +="<table>";
  content +="<tr>";
  content +="<td></td>";
  content +="<td><button  class=\"pm_btn\" type=\"button\" onclick=\"controlPm(1)\">Forward</button></td>";
  content +="<td></td>";
  content +="</tr>";

  content +="<tr>";
  content +="<td><button  class=\"pm_btn\" type=\"button\" onclick=\"controlPm(3)\">Left</button></td>";
  content +="<td><button  class=\"pm_btn\" style=\"background: #ed3db5;\" type=\"button\" onclick=\"controlPm(99)\">STOP</button></td>";
  content +="<td><button  class=\"pm_btn\" type=\"button\" onclick=\"controlPm(4)\">Right</button></td>";
  content +="</tr>";

  content +="<tr>";
  content +="<td></td>";
  content +="<td><button  class=\"pm_btn\" type=\"button\" onclick=\"controlPm(2)\">Backward</button></td>";
  content +="<td></td>";
  content +="</tr>";
  content +="</table>";

  content +="<table>";
  content +="<tr>";
  content +="<td><button class=\"pms_btn\"  type=\"button\" onclick=\"controlPms(1)\">Bow</button></td>";
  content +="<td><button  class=\"pms_btn\" type=\"button\" onclick=\"controlPms(4)\">Apache</button></td>";
  content +="</tr>";
  content +="<tr>";
  content +="<td><button class=\"pms_btn\"  type=\"button\" onclick=\"controlPms(2)\">Waving</button></td>";
  content +="<td><button  class=\"pms_btn\" type=\"button\" onclick=\"controlPms(5)\">Balance</button></td>";
  content +="</tr>";
  content +="<tr>";
  content +="<td><button class=\"pms_btn\"  type=\"button\" onclick=\"controlPms(3)\">Iron Man</button></td>";
  content +="<td><button  class=\"pms_btn\" type=\"button\" onclick=\"controlPms(6)\">Warm-Up</button></td>";
  content +="</tr>";
  content +="<tr>";
  content +="<td colspan=\"2\"><center><button  class=\"pms_btn\" type=\"button\" onclick=\"controlPms(99)\">Auto</button></center></td>";

  content +="</tr>";
  content +="</table>";

  content +="</body>";
  content +="<script>";
  content +="function controlPm(id) {";
  content +="var xhttp = new XMLHttpRequest();";
  content +="xhttp.onreadystatechange = function() {";
  content +="    if (xhttp.readyState == 4 && xhttp.status == 200) {";

  content +="    }";
  content +="  };";
  content +="  xhttp.open(\"GET\", \"controller?pm=\"+id, true);";
  content +="  xhttp.send();";
  content +="}";
  content +="function controlPms(id) {";
  content +="  var xhttp = new XMLHttpRequest();";
  content +="  xhttp.onreadystatechange = function() {";
  content +="    if (xhttp.readyState == 4 && xhttp.status == 200) {";

  content +=" }";
  content +="  };";
  content +="  xhttp.open(\"GET\", \"controller?pms=\"+id, true);";
  content +="  xhttp.send();";
  content +="}";
  content +="</script>";
  content +="</html>";








  
  server.send(200, "text/html", content);
  
}


void enableWebServer(){
  
  HTTPMethod postMethod = HTTP_GET;
  
  server.on("/controller", postMethod, handleController);

  server.on("/", postMethod, handleIndex);
  server.on("/zero", postMethod, handleZero);
  server.on("/editor", postMethod, handlerEditor);
  /*
  server.on("/servo", []() {
    String ival;

    // OE , LOW = On , High = Off
    
    ival = server.arg("oe");
    Servo_OE = ival.toInt();

    ival = server.arg("pm");
    Servo_PROGRAM = ival.toInt();

    ival = server.arg("pms");
    Servo_PROGRAM_Stack = ival.toInt();

    ival = server.arg("gpid");
    GPIO_ID = ival.toInt();

    if (GPIO_ID == 12) {
      ival = server.arg("pwm");
      GPIO12_PWM = ival.toInt();
      GPIO12SERVO.write(GPIO12_PWM);
    }

    if (GPIO_ID == 14) {
      ival = server.arg("pwm");
      GPIO14_PWM = ival.toInt();
      GPIO14SERVO.write(GPIO14_PWM);
    }

    if (Servo_PROGRAM == 0 && Servo_PROGRAM_Stack == 0 && GPIO_ID == 0) {
      ival = server.arg("id");
      int Servo_ID = ival.toInt();
      ival = server.arg("pwm");
      int Servo_PWM = ival.toInt();
      int pulselength = map(Servo_PWM, 0, 180, SERVOMIN, SERVOMAX);
      pwm.setPWM(Servo_ID, 0, pulselength);
    }

    server.send(10, "text/plain");
    
  });
  */

  server.begin();
  //Serial.print("service enable");
  
}
